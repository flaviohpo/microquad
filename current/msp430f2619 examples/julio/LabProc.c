#include <stdio.h>
#include <stdlib.h>
#include <signal.h>
#include <msp430x2619.h>
#include "delay.h"
#include "LabProc.h"



#define LCD_NCHAR   16
#define LCD_NLINE   8

#define _graus 128
#define _up 129
#define _down 130
#define _left 131
#define _right 132
#define _enter 133

#define CR 0x0d
#define LF 0x0a

#define virado     1
#define nao_virado 0


//
// ****************************************************************
// ** C O N S T A N T E S                                        **
// ****************************************************************
//
const unsigned char mask[8] = {0x80, 0x40, 0x20, 0x10, 0x08, 0x04, 0x02, 0x01};

//
//  Tabela ASCII do fonte 7x5
//
const char asciitable[] = {
                            0x00,0x00,0x00,0x00,0x00,
                            0x3E,0x0A,0x34,0x00,0x3E,
                            0x18,0x3E,0x00,0x3E,0x22,
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                            0x10,0x38,0x7C,0x10,0x1E   // _enter
                         };


//
// ****************************************************************
// ** V A R I Á V E I S  D O  D I S P L A Y                      **
// ****************************************************************
//
unsigned char LCD_linecount;
unsigned char LCD_charcount;


// ****************************************************************
// ** PROTÓTIPOS                                                 **
// ****************************************************************
//
int putchar(int c);
void lcd_wrcommand(unsigned char cmd);
void lcd_wrdata(unsigned char dat);
void lcd_initmodule(unsigned char state);
void lcd_setcontraste(unsigned char v);

void lcd_clrscr(void);
void lcd_on(void);
void lcd_off(void);
void lcd_reverse(void);
void lcd_normal(void);
void lcd_newline(void);
void lcd_goto(unsigned char x, unsigned char y);
void lcd_wrchar(unsigned char c);
void lcd_putchar(unsigned char c);
void lcd_putlogo(const unsigned char *p);


// ****************************************************************
// ** MAIN                                                       **
// ****************************************************************
//
int main (void)
{
  int i;

  configura_cpu();
  lcd_initmodule(nao_virado);

  // Testa a tabela ASCII...
  //
  for(i=0; i<128; i++) lcd_putchar(i);  
  delayms(2000);
  
  lcd_clrscr();
  printf("Julio Cesar\r");
  
  lcd_goto(0,2);
  printf("Utilizando LCD\r");
  printf("Nokia 2112\r");

  lcd_goto(0,7);
  printf("(C)2008, by JCL");  
  
  while (1)
  {
    led = 0;
    delayms(200);
    led = 1;
    delayms(500);
  }
}

int putchar(int c)
{
  lcd_putchar(c);
  return 0;
}

//
// ****************************************************************
// ** P R I M I T I V A S  D O  D I S P L A Y  ST7545            **
// ****************************************************************
//
//
// Implementa a temporização da interface SPI de 3 fios para 
// envio de um comando (A0 = 0).
//
void lcd_wrcommand(unsigned char cmd)
{
  unsigned char i;

  CSX = 0;
  SDA = 0;
  SCLK = 1;
  SCLK = 0;
  
  for (i=0; i<8; i++)
  {
    if (cmd & mask[i]) SDA = 1; else SDA = 0;
    SCLK = 1;
    SCLK = 0;
  }

  CSX = 1;
}

//
// Implementa a temporização da interface SPI de 3 fios para 
// escrita de 8 pixeis no display (A0 = 1)
//
void lcd_wrdata(unsigned char dat)
{
  unsigned char i;
 
  CSX = 0;
  SDA = 1;
  SCLK = 1;
  SCLK = 0;
  
  for (i=0; i<8; i++)
  {
    if (dat & mask[i]) SDA = 1; else SDA = 0;
    SCLK = 1;
    SCLK = 0;
  }

  CSX = 1;
}

// ST2007
//
void lcd_initmodule(unsigned char state)
{
  unsigned int i; 

  lcd_wrcommand(0x24); // VOR
  lcd_wrcommand(0x90); // Electronic Volume
  lcd_wrcommand(0xa4); // All off
  lcd_wrcommand(0x2f); // Power Boost on
  lcd_wrcommand(0xb0); // Page 0
  lcd_wrcommand(0x10); // Column 0
  lcd_wrcommand(0x00);
  
  // Zera o conteúdo da RAM  
  for(i=0; i<864; i++) lcd_wrdata(0x00);

  if(state == virado) lcd_wrcommand(0xc8); else lcd_wrcommand(0xa1);
  
  lcd_wrcommand(0xaf); // display on

  LCD_linecount = 0;
  LCD_charcount = 0;
}

void lcd_setcontraste(unsigned char v)
{
  lcd_wrcommand(0xe1);
  lcd_wrcommand(v);
}

void lcd_clrscr(void)
{
  unsigned int i;

  lcd_wrcommand(0xb0); // Page 0
  lcd_wrcommand(0x10); // Column 0
  lcd_wrcommand(0x00);
  
  // Zera o conteúdo da RAM  
  for(i=0; i<864; i++) lcd_wrdata(0x00);

  LCD_linecount = 0;
  LCD_charcount = 0;
}

void lcd_on(void)
{
  lcd_wrcommand(0xaf);
}

void lcd_off(void)
{
  lcd_wrcommand(0xae);
}

void lcd_reverse(void)
{
  lcd_wrcommand(0xa7);
}

void lcd_normal(void)
{
  lcd_wrcommand(0xa6);
}

void lcd_newline(void)
{
  if (++LCD_linecount == LCD_NLINE) LCD_linecount = 0; 
  LCD_charcount = 0;
  lcd_wrcommand(0xb0+LCD_linecount);
  lcd_wrcommand(0x10);
  lcd_wrcommand(0x00);
}

void lcd_goto(unsigned char x, unsigned char y)
{
  unsigned char k;
  
  if (x > LCD_NCHAR-1) x = 0;
  if (y > LCD_NLINE-1) y = 0;

  LCD_charcount = x;
  LCD_linecount = y;
  
  lcd_wrcommand(0xb0+LCD_linecount);
  k = LCD_charcount*6;
  lcd_wrcommand(0x10+(k/16));
  lcd_wrcommand(0x00+(k%16));
}

void lcd_wrchar(unsigned char c)
{
  unsigned int j;
  unsigned char i, v;

  j = (unsigned int) c * 5;
  for (i=0; i<5; i++)
  {
    v = asciitable[j];
    lcd_wrdata(v);
    j += 1;
  }
  lcd_wrdata(0x00);
}

void lcd_putchar(unsigned char c)
{
  switch (c)
  {
    case 13 : lcd_newline();
              break;
    case 10 : LCD_charcount = 0;
              lcd_goto(LCD_charcount, LCD_linecount);
              break;
    default : if (LCD_charcount++ < LCD_NCHAR) lcd_wrchar(c);
              else
              {
                lcd_newline();
                lcd_wrchar(c);
                LCD_charcount++;
              }
  }
}

void lcd_putlogo(const unsigned char *p)
{
  unsigned int i;

  for(i=0; i<864; i++) lcd_wrdata(*(p+i));
}





